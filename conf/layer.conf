## conf/layer.conf
```bitbake
# We have a conf and classes directory, add to BBPATH
BBPATH .= ":${LAYERDIR}"

# We have recipes-* directories, add to BBFILES
BBFILES += "${LAYERDIR}/recipes-*/*/*.bb \
            ${LAYERDIR}/recipes-*/*/*.bbappend"

BBFILES += "${LAYERDIR}/librespot/*.bb \
            ${LAYERDIR}/images/*.bb"

BBFILE_COLLECTIONS += "yoctobsp"
BBFILE_PATTERN_yoctobsp = "^${LAYERDIR}/"
BBFILE_PRIORITY_yoctobsp = "5"
LAYERVERSION_yoctobsp = "2"
```

## conf/machine/include/tune-armv7hl.inc
```bitbake
DEFAULTTUNE ?= "armv7hl"

require conf/machine/include/arm/arch-armv7a.inc

TUNEVALID[armv7hl] = "Enable armv7hl specific processor optimizations"
#TUNE_CCARGS .= "${@bb.utils.contains('TUNE_FEATURES', 'armv7hl', ' -mcpu=armv7-a', '', d)}"

AVAILTUNES += "armv7hl"
ARMPKGARCH_tune-armv7hl = "armv7hl"
TUNE_FEATURES_tune-armv7hl = "${TUNE_FEATURES_tune-armv7a} armv7hl neon callconvention-hard"
PACKAGE_EXTRA_ARCHS_tune-armv7hl = "${PACKAGE_EXTRA_ARCHS_tune-armv7a} armv7hl"
TUNE_PKGARCH = "armv7hl"
```
